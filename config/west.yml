## config/west.yml
```yaml
manifest:
  remotes:
    - name: zmkfirmware
      url-base: https://github.com/zmkfirmware
    - name: sekigon-gonnoc
      url-base: https://github.com/sekigon-gonnoc
    - name: oleksandrmaslov
      url-base: https://github.com/oleksandrmaslov
    - name: nat-chan
      url-base: https://github.com/nat-chan
  projects:
    - name: zmk-pointing-acceleration
      remote: oleksandrmaslov
      revision: 0da8f97f8f2abb18fcc9d488b25357511922cf32
    # cormoran fork (custom studio RPC対応) のnat-chanミラー
    - name: zmk
      remote: nat-chan
      revision: 35bb5dafecd5931c432c74e1b630cf12097671e4
      import: app/west.yml
    - name: zmk-component-bmp-boost
      remote: sekigon-gonnoc
      import: west.yml
      revision: v0.2
    - name: zmk-feature-status-led
      remote: sekigon-gonnoc
      revision: main
    - name: zmk-driver-paw3222
      remote: sekigon-gonnoc
      revision: torabo-tsuki
    - name: zmk-driver-iqs7211e
      remote: sekigon-gonnoc
    - name: zmk-feature-cdc-acm-bootloader-trigger
      remote: sekigon-gonnoc
      revision: v0.2
    - name: zmk-feature-non-lipo-battery-management
      remote: sekigon-gonnoc
      revision: main
  self:
    path: config
```
